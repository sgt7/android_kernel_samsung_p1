## Kernel/arch/arm/configs/p1_defconfig
```kconfig
CONFIG_EXPERIMENTAL=y
# CONFIG_LOCALVERSION_AUTO is not set
CONFIG_SYSVIPC=y
CONFIG_CGROUPS=y
CONFIG_CGROUP_DEBUG=y
CONFIG_CGROUP_FREEZER=y
CONFIG_CGROUP_CPUACCT=y
CONFIG_RESOURCE_COUNTERS=y
CONFIG_CGROUP_SCHED=y
CONFIG_RT_GROUP_SCHED=y
CONFIG_BLK_DEV_INITRD=y
CONFIG_EMBEDDED=y
CONFIG_KALLSYMS_ALL=y
CONFIG_ASHMEM=y
# CONFIG_AIO is not set
# CONFIG_SLUB_DEBUG is not set
CONFIG_MODULES=y
CONFIG_MODULE_FORCE_LOAD=y
CONFIG_MODULE_UNLOAD=y
CONFIG_MODULE_FORCE_UNLOAD=y
# CONFIG_BLK_DEV_BSG is not set
CONFIG_ARCH_S5PV210=y
CONFIG_S3C_LOWLEVEL_UART_PORT=2
CONFIG_S3C_DEV_HSMMC1=y
CONFIG_S3C_DEV_HSMMC3=y
CONFIG_S5P_HIGH_RES_TIMERS=y
CONFIG_S5PV210_SD_CH0_8BIT=y
CONFIG_S5PV210_SCLKFIMD_USE_VPLL=y
# CONFIG_TARGET_PCLK_44_46 is not set
# CONFIG_TARGET_PCLK_47_6 is not set
CONFIG_TARGET_PCLK_54=y
CONFIG_MACH_HERRING is not set
CONFIG_MACH_P1=y
CONFIG_MACH_P1_GSM=y
CONFIG_WIFI_CONTROL_FUNC=y
CONFIG_ARM_THUMBEE=y
CONFIG_FIQ_DEBUGGER=y
CONFIG_FIQ_DEBUGGER_CONSOLE=y
CONFIG_PREEMPT=y
CONFIG_AEABI=y
CONFIG_CMDLINE="console=ttyFIQ0"
CONFIG_CPU_FREQ=y
CONFIG_CPU_FREQ_LOG=y
CONFIG_CPU_FREQ_DEFAULT_GOV_ONDEMAND=y
CONFIG_CPU_FREQ_GOV_POWERSAVE=y
CONFIG_CPU_FREQ_GOV_USERSPACE=y
CONFIG_CPU_FREQ_GOV_CONSERVATIVE=y
CONFIG_CPU_IDLE=y
CONFIG_DVFS_LIMIT=y
CONFIG_VFP=y
CONFIG_NEON=y
CONFIG_BINFMT_MISC=y
CONFIG_PM=y
CONFIG_WAKELOCK=y
CONFIG_APM_EMULATION=y
CONFIG_NET=y
CONFIG_PACKET=y
CONFIG_UNIX=y
CONFIG_NET_KEY=y
CONFIG_INET=y
CONFIG_INET_ESP=y
# CONFIG_NET_ACTIVITY_STATS is not set
# CONFIG_INET_XFRM_MODE_TUNNEL is not set
# CONFIG_INET_XFRM_MODE_BEET is not set
# CONFIG_INET_LRO is not set
CONFIG_IPV6=y
CONFIG_TUN=y
CONFIG_IPV6_PRIVACY=y
CONFIG_IPV6_ROUTER_PREF=y
CONFIG_IPV6_OPTIMISTIC_DAD=y
CONFIG_INET6_AH=y
CONFIG_INET6_ESP=y
CONFIG_INET6_IPCOMP=y
CONFIG_IPV6_MIP6=y
CONFIG_IPV6_TUNNEL=y
CONFIG_IPV6_MULTIPLE_TABLES=y
CONFIG_NETFILTER=y
CONFIG_NETFILTER_NETLINK_QUEUE=y
CONFIG_NETFILTER_NETLINK_LOG=y
CONFIG_NF_CONNTRACK=y
CONFIG_NF_CONNTRACK_EVENTS=y
CONFIG_NF_CT_PROTO_DCCP=y
CONFIG_NF_CT_PROTO_SCTP=y
CONFIG_NF_CT_PROTO_UDPLITE=y
CONFIG_NF_CONNTRACK_AMANDA=y
CONFIG_NF_CONNTRACK_FTP=y
CONFIG_NF_CONNTRACK_H323=y
CONFIG_NF_CONNTRACK_IRC=y
CONFIG_NF_CONNTRACK_NETBIOS_NS=y
CONFIG_NF_CONNTRACK_PPTP=y
CONFIG_NF_CONNTRACK_SANE=y
CONFIG_NF_CONNTRACK_SIP=y
CONFIG_NF_CONNTRACK_TFTP=y
CONFIG_NF_CT_NETLINK=y
CONFIG_NETFILTER_XT_TARGET_CLASSIFY=y
CONFIG_NETFILTER_XT_TARGET_CONNMARK=y
CONFIG_NETFILTER_XT_TARGET_LED=y
CONFIG_NETFILTER_XT_TARGET_MARK=y
CONFIG_NETFILTER_XT_TARGET_NFQUEUE=y
CONFIG_NETFILTER_XT_MATCH_COMMENT=y
CONFIG_NETFILTER_XT_MATCH_CONNBYTES=y
CONFIG_NETFILTER_XT_MATCH_CONNLIMIT=y
CONFIG_NETFILTER_XT_MATCH_CONNMARK=y
CONFIG_NETFILTER_XT_MATCH_CONNTRACK=y
CONFIG_NETFILTER_XT_MATCH_HASHLIMIT=y
CONFIG_NETFILTER_XT_MATCH_HELPER=y
CONFIG_NETFILTER_XT_MATCH_IPRANGE=y
CONFIG_NETFILTER_XT_MATCH_LENGTH=y
CONFIG_NETFILTER_XT_MATCH_LIMIT=y
CONFIG_NETFILTER_XT_MATCH_MAC=y
CONFIG_NETFILTER_XT_MATCH_MARK=y
CONFIG_NETFILTER_XT_MATCH_OWNER=y
CONFIG_NETFILTER_XT_MATCH_POLICY=y
CONFIG_NETFILTER_XT_MATCH_PKTTYPE=y
CONFIG_NETFILTER_XT_MATCH_QUOTA=y
CONFIG_NETFILTER_XT_MATCH_STATE=y
CONFIG_NETFILTER_XT_MATCH_STATISTIC=y
CONFIG_NETFILTER_XT_MATCH_STRING=y
CONFIG_NETFILTER_XT_MATCH_TIME=y
CONFIG_NETFILTER_XT_MATCH_U32=y
CONFIG_NF_CONNTRACK_IPV4=y
CONFIG_IP_MULTICAST=y
CONFIG_IP_NF_IPTABLES=y
CONFIG_IP_NF_MATCH_ADDRTYPE=y
CONFIG_IP_NF_MATCH_AH=y
CONFIG_IP_NF_MATCH_ECN=y
CONFIG_IP_NF_MATCH_TTL=y
CONFIG_IP_NF_FILTER=y
CONFIG_IP_NF_TARGET_REJECT=y
CONFIG_IP_NF_TARGET_LOG=y
CONFIG_NF_NAT=y
CONFIG_IP_NF_TARGET_MASQUERADE=y
CONFIG_IP_NF_TARGET_NETMAP=y
CONFIG_IP_NF_TARGET_REDIRECT=y
CONFIG_IP_NF_ARPTABLES=y
CONFIG_IP_NF_ARPFILTER=y
CONFIG_IP_NF_ARP_MANGLE=y
CONFIG_NET_SCHED=y
CONFIG_NET_SCH_HTB=y
CONFIG_NET_SCH_INGRESS=y
CONFIG_NET_CLS_U32=y
CONFIG_NET_EMATCH=y
CONFIG_NET_EMATCH_U32=y
CONFIG_NET_CLS_ACT=y
CONFIG_NET_ACT_POLICE=y
CONFIG_NET_ACT_GACT=y
CONFIG_NET_ACT_MIRRED=y
CONFIG_PHONET=y
CONFIG_BT=y
CONFIG_BT_L2CAP=y
CONFIG_BT_SCO=y
CONFIG_BT_RFCOMM=y
CONFIG_BT_RFCOMM_TTY=y
CONFIG_BT_HCIUART=y
CONFIG_BT_HCIUART_H4=y
CONFIG_WIRELESS=y
CONFIG_WIRELESS_EXT=y
CONFIG_WEXT_CORE=y
CONFIG_WEXT_PROC=y
CONFIG_WEXT_PRIV=y
# CONFIG_CFG80211 is not set
CONFIG_WIRELESS_EXT_SYSFS=y
# CONFIG_LIB80211 is not set
CONFIG_RFKILL=y
CONFIG_RFKILL_PM=y
CONFIG_RFKILL_INPUT=y
CONFIG_INPUT_MISC=y
# CONFIG_GYRO_K3G is not set
CONFIG_INPUT_UINPUT=y

#
# Character devices
#
CONFIG_VT=y
CONFIG_CONSOLE_TRANSLATIONS=y
CONFIG_VT_CONSOLE=y
CONFIG_HW_CONSOLE=y

CONFIG_UEVENT_HELPER_PATH=""
CONFIG_MTD=y
# CONFIG_MTD_CONCAT is not set
# CONFIG_MTD_CHAR is not set
# CONFIG_MTD_BLOCK is not set
# CONFIG_MTD_ONENAND is not set
# CONFIG_MTD_ONENAND_SAMSUNG is not set

#
# Built-in PARAM driver
#
CONFIG_PARAM_BUILT_IN=m

#
# LinuStoreIII Flash Devices (FSR)
#
CONFIG_RFS_FSR=m
# CONFIG_OND is not set
CONFIG_OND_4K=y
# CONFIG_FND is not set
CONFIG_ONDC_DMA_ENABLE=y
CONFIG_RFS_FSR_STL=m
CONFIG_RFS_STL_DELETE=y
# CONFIG_RFS_FSR_STL_BENCHMARK is not set
# CONFIG_FSR_DUAL_VOLUME is not set
CONFIG_FSR_FLASH_PHYS_ADDR=0xB0000000
CONFIG_LINUSTOREIII_DEBUG_VERBOSE=0
CONFIG_LINUSTOREIII_DEBUG=y

#
# TinyFSR Support for cramfs
#
CONFIG_TINY_FSR=y
# CONFIG_ONENAND is not set
CONFIG_ONENAND_4K=y
# CONFIG_FLEXOND is not set
CONFIG_TINY_FLASH_PHYS_ADDR=0xB0000000
CONFIG_LINUSTOREIII_TINY_DEBUG_VERBOSE=0
CONFIG_BLK_DEV=y
CONFIG_BLK_DEV_LOOP=y
CONFIG_BLK_DEV_RAM=y
CONFIG_BLK_DEV_RAM_COUNT=16
CONFIG_BLK_DEV_RAM_SIZE=8192
CONFIG_MISC_DEVICES=y
CONFIG_ANDROID_PMEM=y
CONFIG_BLK_DEV_LOOP=y
CONFIG_BLK_DEV_RAM=y
CONFIG_BLK_DEV_RAM_SIZE=8192
CONFIG_APANIC=y
CONFIG_SCSI=y
CONFIG_BLK_DEV_SD=y
CONFIG_CHR_DEV_SG=y
CONFIG_NETDEVICES=y
CONFIG_IFB=y
CONFIG_WLAN=y
CONFIG_BROADCOM_WIFI=m
CONFIG_BROADCOM_WIFI_RESERVED_MEM=y
CONFIG_WLAN_SAMSUNG_MEMSIZE_BCM=256
CONFIG_INPUT_EVDEV=y
# CONFIG_KEYPAD_S3C is not set
# CONFIG_KEYPAD_CYPRESS_TOUCH is not set
# CONFIG_INPUT_MOUSE is not set
CONFIG_INPUT_TOUCHSCREEN=y
# CONFIG_TOUCHSCREEN_MXT224 is not set
CONFIG_TOUCHSCREEN_QT602240=y
CONFIG_KEYBOARD_P1=y
# CONFIG_INPUT_KEYCHORD is not set
CONFIG_KEYBOARD_GPIO=y
CONFIG_INPUT_GPIO=y
# CONFIG_SERIAL_8250 is not set
CONFIG_SERIAL_SAMSUNG=y
CONFIG_SERIAL_SAMSUNG_CONSOLE=y
# CONFIG_CRESPO_LEGACY_MODEM is not set
CONFIG_SAMSUNG_MODEMCTL=y
CONFIG_SVNET_WHITELIST=y
# CONFIG_PN544 is not set
CONFIG_HW_RANDOM=y
CONFIG_I2C=y
CONFIG_I2C_CHARDEV=y
CONFIG_I2C_GPIO=y
CONFIG_I2C_S3C2410=y
CONFIG_GPIO_SYSFS=y
CONFIG_POWER_SUPPLY=y
# CONFIG_BATTERY_MAX17040 is not set
CONFIG_BATTERY_MAX17042=y
CONFIG_CHARGER_SMB136=y
CONFIG_BATTERY_P1=y
# CONFIG_BATTERY_S5PC110 is not set
# CONFIG_HWMON is not set
CONFIG_HWMON=y
CONFIG_REGULATOR=y
CONFIG_REGULATOR_MAX8998=y
CONFIG_MFD_MAX8998=y
CONFIG_MEDIA_SUPPORT=y
CONFIG_VIDEO_DEV=y
# CONFIG_IR_CORE is not set
CONFIG_VIDEO_ISX005=y
CONFIG_VIDEO_S5K6AAFX=y
CONFIG_VIDEO_S5K5CCGX=y
# CONFIG_VIDEO_S5K4ECGX is not set
# CONFIG_VIDEO_S5KA3DFX is not set
CONFIG_VIDEO_SAMSUNG=y
CONFIG_VIDEO_SAMSUNG_V4L2=y
CONFIG_VIDEO_FIMC=y
CONFIG_VIDEO_FIMC_RANGE_NARROW=y
# CONFIG_VIDEO_FIMC_MIPI is not set
CONFIG_VIDEO_MFC50=y
CONFIG_VIDEO_JPEG_V2=y

#config for HDMI
CONFIG_30PIN_CONN=y
CONFIG_MHL_SII9234=y
CONFIG_VIDEO_TV20=y
# CONFIG_HDMI_CEC is not set
CONFIG_HDMI_HPD=y 

CONFIG_FB=y
CONFIG_FB_S3C=y
CONFIG_FB_S3C_NR_BUFFERS=2
# CONFIG_FB_S3C_TL2796 is not set
CONFIG_FB_S3C_LVDS=y
CONFIG_FB_S3C_MDNIE=y
CONFIG_FB_S3C_CMC623=y
CONFIG_BACKLIGHT_LCD_SUPPORT=y
CONFIG_LCD_CLASS_DEVICE=y
CONFIG_BACKLIGHT_CLASS_DEVICE=y
# CONFIG_BACKLIGHT_NT39411B is not set
# CONFIG_BACKLIGHT_MDNIE_PWM is not set
CONFIG_BACKLIGHT_CMC623_PWM=y
# CONFIG_BACKLIGHT_GENERIC is not set
# CONFIG_VGA_CONSOLE is not set
# CONFIG_FRAMEBUFFER_CONSOLE is not set
CONFIG_SOUND=y
CONFIG_SND=y
CONFIG_SND_SOC=y
CONFIG_SND_S3C24XX_SOC=y
CONFIG_SND_S5P_WM8994=y
CONFIG_SND_C110_PCM=y
CONFIG_SND_S5P_RP=y
# CONFIG_S5P_INTERNAL_DMA is not set
CONFIG_HID_SUPPORT=y
CONFIG_BT_HID=m
CONFIG_BT_HIDP=y
CONFIG_USB_GADGET=y
CONFIG_USB_GADGET_VBUS_DRAW=500

CONFIG_USB_GADGET_S3C_OTGD=y
CONFIG_USB_S3C_OTGD=y
CONFIG_USB_GADGET_S3C_OTGD_DMA_MODE=y
# CONFIG_USB_GADGET_S3C_OTGD_SLAVE_MODE is not set
CONFIG_USB_GADGET_DUALSPEED=y
#
CONFIG_USB_ANDROID=y
CONFIG_USB_ANDROID_ACM=y
CONFIG_USB_DUN_SUPPORT=y
CONFIG_USB_ANDROID_ADB=y
CONFIG_USB_ANDROID_MASS_STORAGE=y
# CONFIG_USB_ANDROID_MTP is not set
CONFIG_USB_ANDROID_RNDIS=y
CONFIG_USB_ANDROID_RNDIS_WCEIS=y
CONFIG_USB_ANDROID_SAMSUNG_COMPOSITE=y
# CONFIG_USB_ANDROID_SAMSUNG_ESCAPE is not set
# CONFIG_CONFIG_USB_ANDROID_SAMSUNG_RNDIS_WITH_MS_COMPOSITE is not set
CONFIG_USB_ANDROID_SAMSUNG_MTP=y
# CONFIG_USB_CDC_COMPOSITE is not set
# CONFIG_USB_G_NOKIA is not set
# CONFIG_USB_G_MULTI is not set
# CONFIG_USB_G_HID is not set
# CONFIG_USB_G_WEBCAM is not set


CONFIG_MMC=y
CONFIG_MMC_UNSAFE_RESUME=y
CONFIG_MMC_BLOCK_DEFERRED_RESUME=y
CONFIG_MMC_SDHCI=y
CONFIG_MMC_SDHCI_S3C=y
CONFIG_MMC_SDHCI_S3C_DMA=y
CONFIG_SWITCH=y
CONFIG_RTC_CLASS=y
CONFIG_RTC_DRV_S3C=y
CONFIG_STAGING=y
# CONFIG_STAGING_EXCLUDE_BUILD is not set
CONFIG_ANDROID=y
CONFIG_ANDROID_BINDER_IPC=y
CONFIG_ANDROID_LOGGER=y
CONFIG_ANDROID_RAM_CONSOLE=y
CONFIG_ANDROID_RAM_CONSOLE_ERROR_CORRECTION=y
CONFIG_ANDROID_TIMED_GPIO=y
CONFIG_ANDROID_LOW_MEMORY_KILLER=y

#
# for P1 Vibrator
#
CONFIG_VIBTONZ=m

#
# File systems
#
CONFIG_EXT2_FS=y
# CONFIG_EXT4_FS is not set
# CONFIG_EXT4_USE_FOR_EXT23 is not set
# CONFIG_EXT4_FS_XATTR is not set
# CONFIG_EXT4_DEBUG is not set
# CONFIG_DNOTIFY is not set
CONFIG_INOTIFY=y
CONFIG_MSDOS_FS=y
CONFIG_VFAT_FS=y
CONFIG_TMPFS=y
CONFIG_TMPFS_POSIX_ACL=y
CONFIG_YAFFS_FS=y

CONFIG_MISC_FILESYSTEMS=y

#
# RFS Filesystem
#
CONFIG_RFS_FS=m
CONFIG_RFS_DEFAULT_IOCHARSET="utf8"
CONFIG_RFS_FS_PERMISSION=y
# CONFIG_RFS_FS_XATTR is not set
CONFIG_RFS_FS_SYNC_ON_CLOSE=y
CONFIG_RFS_FS_ERASE_SECTOR=y
CONFIG_RFS_FS_SPECIAL=y
CONFIG_RFS_FS_CORE_FAT=m
CONFIG_RFS_FS_FAT_VFAT=y
CONFIG_CRAMFS=y
CONFIG_ROMFS_FS=y
CONFIG_ROMFS_BACKED_BY_BLOCK=y
CONFIG_ROMFS_ON_BLOCK=y
CONFIG_SYSV_FS=y
CONFIG_PARTITION_ADVANCED=y
CONFIG_BSD_DISKLABEL=y
CONFIG_SOLARIS_X86_PARTITION=y
CONFIG_NLS_CODEPAGE_437=y
CONFIG_NLS_ASCII=y
CONFIG_NLS_ISO8859_1=y
CONFIG_NLS_UTF8=y
CONFIG_MAGIC_SYSRQ=y
CONFIG_DEBUG_KERNEL=y
# CONFIG_DEBUG_PREEMPT is not set
CONFIG_DEBUG_RT_MUTEXES=y
CONFIG_DEBUG_SPINLOCK=y
CONFIG_DEBUG_MUTEXES=y
CONFIG_DEBUG_SPINLOCK_SLEEP=y
CONFIG_DEBUG_INFO=y
# CONFIG_RCU_CPU_STALL_DETECTOR is not set
CONFIG_SYSCTL_SYSCALL_CHECK=y
# CONFIG_ARM_UNWIND is not set
CONFIG_DEBUG_USER=y
CONFIG_DEBUG_ERRORS=y
CONFIG_DEBUG_S3C_UART=2
CONFIG_CRC_CCITT=y
CONFIG_PPP=y
CONFIG_PPP_DEFLATE=y
CONFIG_PPP_BSDCOMP=y
CONFIG_PPP_MPPE=y
CONFIG_PPPOLAC=y
CONFIG_PPPOPNS=y
# CONFIG_SWAP is not set
CONFIG_DEBUG_FS=y
CONFIG_EFI_PARTITION=y
# CONFIG_LEGACY_PTYS is not set
CONFIG_PVR_SGX=y
CONFIG_PVR_BUILD_RELEASE=y
# CONFIG_PVR_BUILD_DEBUG is not set
CONFIG_PVR_NEED_PVR_DPF=y
CONFIG_PVR_NEED_PVR_ASSERT=y
CONFIG_PVR_PERCONTEXT_PB=y
CONFIG_PVR_ACTIVE_POWER_MANAGEMENT=y
CONFIG_PVR_ACTIVE_POWER_LATENCY_MS=100
CONFIG_PVR_SGX_LOW_LATENCY_SCHEDULING=y
CONFIG_PVR_USSE_EDM_STATUS_DEBUG=y
CONFIG_PVR_DUMP_MK_TRACE=y
# CONFIG_PVR_PDUMP is not set
CONFIG_PANIC_TIMEOUT=5
#
# Sensor support
#
CONFIG_SENSOR=y
CONFIG_ACCEL=y
CONFIG_ACCEL_BMA020=y
CONFIG_COMPASS=y
CONFIG_COMPASS_AK8973B=y
CONFIG_GYRO=y
CONFIG_GYRO_L3G4200D=y
CONFIG_LIGHT=y
CONFIG_LIGHT_BH1721=y


CONFIG_MD=y
CONFIG_BLK_DEV_DM=y
CONFIG_DM_DEBUG=y
CONFIG_DM_CRYPT=y
CONFIG_DM_UEVENT=y
CONFIG_LOCALVERSION_AUTO=y
CONFIG_PRINTK_TIME=y
# CONFIG_SAMSUNG_JACK is not set
CONFIG_SEC_HEADSET=y
CONFIG_CRYPTO_HMAC=y
CONFIG_CRYPTO_MD5=y
CONFIG_CRYPTO_SHA1=y
CONFIG_CRYPTO_AES=y
CONFIG_CRYPTO_DES=y
CONFIG_CRYPTO_TWOFISH=y
CONFIG_USB_SWITCH_FSA9480=y
CONFIG_NET_ACTIVITY_STATS=y
CONFIG_UID_STAT=y
#
# Samsung Kernel Debug Features
#
CONFIG_KERNEL_DEBUG_SEC=y
```

## drivers/media/video/samsung/Kconfig
```kconfig
config VIDEO_SAMSUNG
	bool "Samsung Multimedia Devices"
	depends on VIDEO_CAPTURE_DRIVERS && VIDEO_V4L2
	select VIDEO_FIXED_MINOR_RANGES
	default n
	---help---
	  This is a representative video4linux configuration for Samsung multimedia devices.

config VIDEO_SAMSUNG_V4L2
	bool "V4L2 API for digital camera to be contributed by samsung"
	depends on VIDEO_DEV && VIDEO_SAMSUNG
	default n
	---help---
	 This feature is for new V4L2 APIs all about digital camera

config VIDEO_NM6XX
        tristate "NM6XX Tunner Sensor"
        depends on VIDEO_V4L2 && ISDBT_NMI
        ---help---
          This driver supports NM6XX Analog TV module

if CPU_S5PV210
source "drivers/media/video/samsung/fimc/Kconfig"
source "drivers/media/video/samsung/mfc50/Kconfig"
source "drivers/media/video/samsung/jpeg_v2/Kconfig"
source "drivers/media/video/samsung/tv20/Kconfig"
source "drivers/media/video/samsung/tsi/Kconfig"
source "drivers/media/video/samsung/nmi625/Kconfig"
if CPU_S5PV210_EVT1
#source "drivers/media/video/samsung/rotator/Kconfig"
source "drivers/media/video/samsung/g2d/Kconfig"
endif
endif
```

## drivers/media/video/samsung/g2d/Kconfig
```kconfig
# drivers/media/video/samsung/g2d/Kconfig
#
# Copyright (c) 2010 Samsung Electronics Co., Ltd.
# 		http://www.samsung.com/
#
# Licensed under GPLv2

config VIDEO_G2D
	bool "Samsung FIMG-2D Driver"
	depends on VIDEO_SAMSUNG && (CPU_S5PV210)
	default n
	help
	  This is a graphics 2D (FIMG2D) driver for Samsung S5PV210.

config VIDEO_G2D_DEBUG
	bool "G2D Driver Debug Messages"
	depends on VIDEO_G2D
	default n
	help
	  This enables G2D driver debug messages.
```

## drivers/sensor/Kconfig
```kconfig
#
#
#


menuconfig SENSOR
	bool "Sensors Support"
	help
	  Say Y to enable Sensors support.  This allows control of supported
	  Sensors.

	  
	  

if SENSOR

source "drivers/sensor/accel/Kconfig"

source "drivers/sensor/compass/Kconfig"

source "drivers/sensor/gyro/Kconfig"

source "drivers/sensor/light/Kconfig"

endif # SENSOR
```

## drivers/sensor/accel/Kconfig
```kconfig
#
# Accelerometer Sensor Configuration
#



config ACCEL                                                              
	bool "Accelerometer Sensor"
	default y
	help
	This option enables accelerometer sensors  
	   

config ACCEL_BMA020
	depends on ACCEL
	tristate "BMA020 driver for s5pc110"
	default y
	help
	  This option enables accelerometer sensors using bma020 driver.

config ACCEL_BMA020_SWAPXY
	depends on ACCEL_BMA020
        bool "BMA020: Swap X and Y"
	default n
	help
	  This option swaps x and y.
	  
```

## drivers/sensor/compass/Kconfig
```kconfig
#
# MAGNETIC Sensor Configuration
#

config COMPASS
	bool "Sensors"
	default y
	help
	  This option enables sensors


config COMPASS_AK8973B
	depends on COMPASS
	tristate "AK8973B driver for s5pc11x"
	default y
	help
	  This option enables magnetic sensors using ak8973b driver
	  It is optimized for s5pc11x
	  
```

## drivers/sensor/gyro/Kconfig
```kconfig
#
# GYRO Sensor Configuration
#

config GYRO
	bool "GYRO Sensors"
	default y
	help
	  This option enables sensors


config GYRO_L3G4200D
	depends on GYRO
	tristate "L3G4200D driver for s5pc11x"
	default y
	help
	  This option enables gyro sensors using L3G4200D driver
	  It is optimized for s5pc11x
	  
```

## drivers/sensor/light/Kconfig
```kconfig
#
# LIGHT Sensor Configuration
#

config LIGHT
	bool "LIGHT Sensors"
	default y
	help
	  This option enables sensors


config LIGHT_BH1721
	depends on LIGHT
	tristate "BH1721 driver for s5pc11x"
	default y
	help
	  This option enables light sensors using BH1721 driver
	  It is optimized for s5pc11x
	  
```

## sound/s5p-rp/Kconfig
```kconfig
config SND_S5P_RP
	tristate "Samsung SoC Audio - RP"
	depends on (ARCH_S5PC1XX || ARCH_S5PC11X || ARCH_S5PV210) && !S5P_INTERNAL_DMA && SND_S3C_I2SV2_SOC
	default n
	help
	  Say Y or M if you want to add support for Audio RP.

config SND_S5P_RP_DEBUG
    bool "Enable debug message for Audio - RP"
    depends on SND_S5P_RP
    default n
    help
      Say Y or M if you want to add debug message for Audio RP.
```
